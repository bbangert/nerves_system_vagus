## dragon_q6a/package/aic8800/Config.in
```kconfig
config BR2_PACKAGE_AIC8800
	bool "aic8800"
	depends on BR2_LINUX_KERNEL
	help
	  Out-of-tree kernel modules for the AIC8800D80 USB WiFi 6 +
	  Bluetooth 5.4 combo chip (the Q6A's onboard Quectel FCU760K,
	  USB a69c:8d80): aic_load_fw (firmware loader), aic8800_fdrv
	  (cfg80211 fullmac WiFi, presents wlan0) and aic_btusb (BT,
	  patched from the vendor's Android-Bluedroid default to
	  register a standard BlueZ hci0).

	  Needs the firmware blobs from BR2_PACKAGE_AIC8800_FIRMWARE
	  at runtime (kept in lockstep with this package).

	  https://github.com/radxa-pkg/aic8800

comment "aic8800 needs a Linux kernel to be built"
	depends on !BR2_LINUX_KERNEL
```

## dragon_q6a/package/dragon-q6a-firmware/Config.in
```kconfig
config BR2_PACKAGE_DRAGON_Q6A_FIRMWARE
	bool "dragon-q6a-firmware"
	select BR2_PACKAGE_LINUX_FIRMWARE
	help
	  Firmware set for the Radxa Dragon Q6A (QCS6490) AI foundation:

	  - GPU (a660 GMU/SQE/zap), Venus video, and GENI QUP firmware plus
	    the board-matched CDSP/ADSP images and their .jsn fastrpc domain
	    descriptors, all sourced from the SAME upstream linux-firmware
	    release Buildroot already downloads (single-source rule).
	  - The Hexagon DSP-side shell/skel binaries (fastrpc_shell_*) from
	    linux-msm/hexagon-dsp-binaries, pinned to a commit whose CDSP
	    shell version string exactly matches the shipped cdsp.mbn
	    (mismatches fail fastrpc with error 0x80000600).

	  https://github.com/linux-msm/hexagon-dsp-binaries
```

## dragon_q6a/package/vagus-crun/Config.in
```kconfig
config BR2_PACKAGE_VAGUS_CRUN
	bool "vagus-crun"
	depends on BR2_USE_MMU # fork()
	depends on BR2_TOOLCHAIN_GCC_AT_LEAST_4_9 # C11/stdatomic.h
	depends on BR2_TOOLCHAIN_HAS_SYNC_4 # json-c
	depends on BR2_PACKAGE_LIBSECCOMP_ARCH_SUPPORTS # libseccomp
	depends on BR2_TOOLCHAIN_HEADERS_AT_LEAST_3_17 # libseccomp
	depends on !BR2_PACKAGE_CRUN # both install /usr/bin/crun
	select BR2_PACKAGE_ARGP_STANDALONE if !BR2_TOOLCHAIN_USES_GLIBC
	select BR2_PACKAGE_JSON_C
	select BR2_PACKAGE_LIBCAP
	select BR2_PACKAGE_LIBSECCOMP
	help
	  crun 1.30.1 (json-c based, replaces YAJL since 1.28), built
	  from the release tarball. Vagus-owned because the stock
	  Buildroot crun package is 1.24 and cannot be redefined from
	  an external tree.

	  https://github.com/containers/crun

comment "vagus-crun needs a glibc or musl toolchain, gcc >= 4.9, headers >= 3.17"
	depends on BR2_USE_MMU
	depends on BR2_PACKAGE_LIBSECCOMP_ARCH_SUPPORTS
	depends on BR2_TOOLCHAIN_USES_UCLIBC || \
		!BR2_TOOLCHAIN_GCC_AT_LEAST_4_9 || \
		!BR2_TOOLCHAIN_HEADERS_AT_LEAST_3_17
```

## ha_green/package/vagus-podman/Config.in
```kconfig
config BR2_PACKAGE_VAGUS_PODMAN
	bool "vagus-podman"
	depends on BR2_USE_MMU # fork()
	depends on BR2_PACKAGE_HOST_GO_TARGET_ARCH_SUPPORTS
	depends on BR2_PACKAGE_HOST_GO_TARGET_CGO_LINKING_SUPPORTS
	depends on BR2_PACKAGE_LIBSECCOMP_ARCH_SUPPORTS # libseccomp
	depends on BR2_TOOLCHAIN_HEADERS_AT_LEAST_3_17 # libseccomp
	depends on BR2_TOOLCHAIN_HAS_THREADS # conmon
	depends on BR2_USE_WCHAR # conmon
	select BR2_PACKAGE_HOST_GO
	select BR2_PACKAGE_CA_CERTIFICATES # runtime
	select BR2_PACKAGE_CATATONIT # runtime
	select BR2_PACKAGE_CONMON # runtime
	select BR2_PACKAGE_CONTAINERS_IMAGE_CONFIG # runtime
	select BR2_PACKAGE_LIBSECCOMP
	help
	  Podman 6 for rootful use on an image without systemd, with
	  its containers.conf and storage.conf.

	  Not selected from here, but required at run time: an OCI
	  runtime at /usr/bin/crun (BR2_PACKAGE_VAGUS_CRUN, or stock
	  BR2_PACKAGE_CRUN), netavark >= 2 (BR2_PACKAGE_VAGUS_NETAVARK)
	  and nft with JSON support (BR2_PACKAGE_NFTABLES_JSON).

	  Rootless use, user namespaces, journald and container DNS
	  (aardvark-dns) are not supported by this build.

	  https://podman.io/

comment "vagus-podman needs a toolchain w/ threads, wchar, headers >= 3.17"
	depends on BR2_USE_MMU
	depends on BR2_PACKAGE_HOST_GO_TARGET_ARCH_SUPPORTS
	depends on BR2_PACKAGE_LIBSECCOMP_ARCH_SUPPORTS
	depends on !BR2_TOOLCHAIN_HAS_THREADS || !BR2_USE_WCHAR \
		|| !BR2_TOOLCHAIN_HEADERS_AT_LEAST_3_17
```

## package/aic8800-firmware/Config.in
```kconfig
config BR2_PACKAGE_AIC8800_FIRMWARE
	bool "aic8800-firmware"
	help
	  Firmware blobs for the AIC8800D80 USB WiFi 6 + Bluetooth 5.4
	  combo chip (the Q6A's onboard Quectel FCU760K), installed to
	  /lib/firmware/aic8800D80/ where the aic8800 driver's loader
	  module requests them. Proprietary Aicsemi binaries,
	  redistributed by Radxa; not part of linux-firmware.

	  https://github.com/radxa-pkg/aic8800
```

## rock_4d/base/package/aic8800/Config.in
```kconfig
config BR2_PACKAGE_AIC8800
	bool "aic8800"
	depends on BR2_LINUX_KERNEL
	help
	  Out-of-tree driver + firmware for the AICSemi AIC8800D80
	  (WiFi 6 + BT 5.4) as found in the ROCK 4D's onboard Quectel
	  FCU760K module, USB-attached. Radxa's packaging of the vendor
	  driver, pinned by commit, with Radxa's debian/patches applied
	  (the stock source does not build on kernel 6.1).

	  Builds aic_load_fw.ko (firmware uploader; binds the cold
	  a69c:8d80 device, uploads firmware, chip re-enumerates as
	  a69c:8d81), aic8800_fdrv.ko (cfg80211 fullmac WiFi -> wlan0)
	  and aic_btusb.ko (BlueZ hci0). All three autoload via USB
	  modalias; firmware is read from
	  /lib/firmware/aic8800_fw/USB/aic8800D80 via filp_open.

	  https://github.com/radxa-pkg/aic8800
```

## rock_4d/base/package/libmali/Config.in
```kconfig
config BR2_PACKAGE_LIBMALI
	bool "libmali"
	depends on BR2_INSTALL_LIBSTDCPP
	depends on BR2_TOOLCHAIN_USES_GLIBC
	depends on BR2_aarch64
	depends on BR2_TOOLCHAIN_HAS_THREADS
	select BR2_PACKAGE_HAS_LIBEGL
	select BR2_PACKAGE_HAS_LIBGLES
	select BR2_PACKAGE_HAS_LIBGBM
	select BR2_PACKAGE_LIBGBM_HAS_FEATURE_DMA_BUF
	select BR2_PACKAGE_LIBGBM_HAS_FEATURE_FORMAT_MODIFIER_PLANE_COUNT
	select BR2_PACKAGE_LIBDRM
	help
	  Proprietary ARM Mali userspace (EGL/GLESv2/GBM) for the
	  Rockchip RK3576 Mali-G52, DDK g29p1, GLES+GBM variant. Pairs
	  with the in-kernel Mali Bifrost module (CONFIG_MALI_BIFROST)
	  that creates /dev/mali0.

	  Forked from Buildroot's rockchip-mali (which is hardcoded to
	  G31). The blob is downloaded from Rockchip's public libmali
	  distribution (JeffyCN/mirrors, pinned by commit, hash-checked);
	  headers and pkgconfig ship in this package.

if BR2_PACKAGE_LIBMALI

config BR2_PACKAGE_PROVIDES_LIBEGL
	default "libmali"

config BR2_PACKAGE_PROVIDES_LIBGLES
	default "libmali"

config BR2_PACKAGE_PROVIDES_LIBGBM
	default "libmali"

endif
```

## rock_4d/base/package/librknnrt/Config.in
```kconfig
config BR2_PACKAGE_LIBRKNNRT
	bool "librknnrt"
	depends on BR2_aarch64
	depends on BR2_TOOLCHAIN_USES_GLIBC
	depends on BR2_INSTALL_LIBSTDCPP
	help
	  Rockchip RKNN runtime (librknnrt.so) for the RK3576 NPU,
	  v2.3.2, matching the in-kernel RKNPU driver (0.9.8). Provides
	  the rknn_api/rknn_matmul_api C interface that application-side
	  NIFs or ports link against; models are built on a host with the
	  rknn-toolkit2 Python tools.

	  Proprietary Rockchip blob, fetched at build time from the
	  public airockchip/rknn-toolkit2 repository, pinned by tag and
	  hash-checked.

	  https://github.com/airockchip/rknn-toolkit2
```

## rock_4d/package/vagus-netavark/Config.in
```kconfig
config BR2_PACKAGE_VAGUS_NETAVARK
	bool "vagus-netavark"
	depends on BR2_PACKAGE_HOST_RUSTC_TARGET_ARCH_SUPPORTS
	depends on BR2_PACKAGE_HOST_PROTOBUF_ARCH_SUPPORTS # host-protobuf
	depends on BR2_USE_WCHAR # nftables
	depends on BR2_TOOLCHAIN_HEADERS_AT_LEAST_3_12 # nftables
	select BR2_PACKAGE_HOST_RUSTC
	select BR2_PACKAGE_NFTABLES # runtime
	select BR2_PACKAGE_NFTABLES_JSON # runtime
	help
	  Vagus-owned netavark 2.x, the network stack podman 6
	  requires (Buildroot ships 1.17.x). nftables is the only
	  kernel firewall driver left in 2.x, and netavark drives it
	  through nft's JSON interface.

	  aardvark-dns is deliberately not selected: without it
	  netavark sets networks up with container DNS disabled.

	  https://github.com/containers/netavark

comment "vagus-netavark needs a toolchain w/ wchar, headers >= 3.12"
	depends on BR2_PACKAGE_HOST_RUSTC_TARGET_ARCH_SUPPORTS
	depends on BR2_PACKAGE_HOST_PROTOBUF_ARCH_SUPPORTS
	depends on !BR2_USE_WCHAR || !BR2_TOOLCHAIN_HEADERS_AT_LEAST_3_12
```

## rubik_pi3/base/package/fastrpc/Config.in
```kconfig
config BR2_PACKAGE_FASTRPC
	bool "fastrpc"
	depends on BR2_TOOLCHAIN_HAS_THREADS
	select BR2_PACKAGE_LIBYAML
	select BR2_PACKAGE_LIBMD
	select BR2_PACKAGE_LIBBSD
	help
	  Qualcomm FastRPC userspace: libcdsprpc/libadsprpc client
	  libraries, the adsprpcd/cdsprpcd remote-processor daemons, and
	  the fastrpc_test diagnostic (with its v68 test skels) for
	  offloading compute to the Hexagon DSPs via the QCOM_FASTRPC
	  kernel driver.

	  https://github.com/qualcomm/fastrpc
```

## rubik_pi3/base/package/rubik-pi3-firmware/Config.in
```kconfig
config BR2_PACKAGE_RUBIK_PI3_FIRMWARE
	bool "rubik-pi3-firmware"
	select BR2_PACKAGE_LINUX_FIRMWARE
	help
	  Firmware set for the Thundercomm Rubik Pi 3 (QCS6490):

	  - GPU (a660 GMU/SQE/zap), Venus video, and GENI QUP firmware plus
	    the CDSP/ADSP images and their .jsn fastrpc domain descriptors,
	    all sourced from the SAME upstream linux-firmware release
	    Buildroot already downloads (single-source rule).
	  - The Hexagon DSP-side shell/skel binaries (fastrpc_shell_*) from
	    linux-msm/hexagon-dsp-binaries, pinned to a commit whose CDSP
	    and ADSP shell version strings exactly match the shipped .mbn
	    images (mismatches fail fastrpc with error 0x80000600).
	  - Broadcom blobs for the onboard AMPAK AP6256 WiFi/BT module:
	    brcmfmac43456 SDIO firmware + CLM blob and the board NVRAM for
	    WiFi, and the BCM4345C5 patchram for hci_bcm Bluetooth.

	  https://github.com/linux-msm/hexagon-dsp-binaries
	  https://github.com/armbian/firmware
	  https://github.com/rubikpi-ai/rubikpi3-firmware
```

## shared/package/vagus-balena-engine/Config.in
```kconfig
config BR2_PACKAGE_VAGUS_BALENA_ENGINE
	bool "vagus-balena-engine"
	depends on BR2_PACKAGE_HOST_GO_TARGET_ARCH_SUPPORTS
	depends on BR2_PACKAGE_HOST_GO_TARGET_CGO_LINKING_SUPPORTS
	depends on BR2_PACKAGE_LIBSECCOMP_ARCH_SUPPORTS # libseccomp
	depends on BR2_TOOLCHAIN_HEADERS_AT_LEAST_3_17 # libseccomp
	depends on !BR2_TOOLCHAIN_USES_UCLIBC # no fexecve
	depends on BR2_USE_MMU # util-linux
	select BR2_PACKAGE_CGROUPFS_MOUNT if !BR2_PACKAGE_SYSTEMD # runtime
	select BR2_PACKAGE_HOST_GO
	select BR2_PACKAGE_IPTABLES # runtime
	select BR2_PACKAGE_LIBSECCOMP
	select BR2_PACKAGE_UTIL_LINUX # runtime
	select BR2_PACKAGE_UTIL_LINUX_BINARIES # runtime
	select BR2_PACKAGE_UTIL_LINUX_MOUNT # runtime
	select BR2_PACKAGE_UTIL_LINUX_MOUNTPOINT # runtime
	select BR2_PACKAGE_UTIL_LINUX_PIVOT_ROOT # runtime
	help
	  Vagus-owned fork of Buildroot's balena-engine package.

	  balenaEngine is a container engine purpose-built for embedded
	  and IoT use cases and compatible with Docker containers. Unlike
	  upstream Buildroot's package (pinned to 20.10.26, no seccomp),
	  this package tracks balenaOS's actually-shipped release/v25.0
	  branch (v25.0.14) and builds with the "seccomp" tag enabled
	  against libseccomp, matching balena-engine's own upstream
	  Dockerfile build-tag default.

	  https://github.com/balena-os/balena-engine

comment "vagus-balena-engine needs a glibc or musl toolchain w/ threads, libseccomp arch support and headers >= 3.17"
	depends on BR2_PACKAGE_HOST_GO_TARGET_ARCH_SUPPORTS
	depends on BR2_PACKAGE_HOST_GO_TARGET_CGO_LINKING_SUPPORTS
	depends on BR2_PACKAGE_LIBSECCOMP_ARCH_SUPPORTS
	depends on !BR2_TOOLCHAIN_HAS_THREADS || BR2_TOOLCHAIN_USES_UCLIBC || !BR2_TOOLCHAIN_HEADERS_AT_LEAST_3_17
	depends on BR2_USE_MMU
```
